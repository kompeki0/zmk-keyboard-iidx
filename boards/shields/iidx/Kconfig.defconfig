## config/west.yml
```yaml
manifest:
  remotes:
    - name: zmkfirmware
      url-base: https://github.com/zmkfirmware
    - name: kompeki0
      url-base: https://github.com/kompeki0
  projects:
    - name: zmk
      remote: zmkfirmware
      revision: main
      clone-depth: 1
      import:
        file: app/west.yml
    - name: zmk-cornix-for-sdvx
      remote: kompeki0
      revision: main
      clone-depth: 1
    - name: zmk-variables
      remote: kompeki0
      revision: main
      clone-depth: 1
    - name: zmk-sensor-rotate-tools
      remote: kompeki0
      revision: main
      clone-depth: 1
  self:
    path: config
```

## dts/bindings/behaviors/zmk,behavior-iidx-boot-select.yaml
```yaml
# Copyright (c) 2026 The zmk-iidx contributors
# SPDX-License-Identifier: MIT

description: Select IIDX mode when held during boot, otherwise invoke a normal behavior

compatible: "zmk,behavior-iidx-boot-select"

include: zero_param.yaml

properties:
  bindings:
    type: phandle-array
    required: true
    description: Two bindings; IIDX mode switch first and normal fallback second

  boot-timeout-ms:
    type: int
    default: 1000
    description: Presses at or before this uptime select IIDX mode
```

## dts/bindings/behaviors/zmk,behavior-iidx-button.yaml
```yaml
# Copyright (c) 2026 The zmk-iidx contributors
# SPDX-License-Identifier: MIT

description: IIDX dedicated HID button press/release behavior

compatible: "zmk,behavior-iidx-button"

include: one_param.yaml
```

## dts/bindings/behaviors/zmk,behavior-iidx-mode.yaml
```yaml
# Copyright (c) 2026 The zmk-iidx contributors
# SPDX-License-Identifier: MIT

description: Toggle between an IIDX layer and a standard USB keyboard layer

compatible: "zmk,behavior-iidx-mode"

include: zero_param.yaml

properties:
  iidx-layer:
    type: int
    required: false
    deprecated: true
    description: Deprecated single IIDX layer to activate in IIDX mode

  iidx-layers:
    type: array
    required: false
    description: Layers to activate together in IIDX mode

  keyboard-layer:
    type: int
    required: false
    deprecated: true
    description: Deprecated single standard keyboard layer to activate

  keyboard-layers:
    type: array
    required: false
    description: Layers to activate together in standard keyboard mode

  default-iidx-mode:
    type: boolean
    description: Start with IIDX HID mode enabled
```

## dts/bindings/behaviors/zmk,behavior-sensor-iidx-x-value.yaml
```yaml
description: Adjust a stored value from a sensor and send it as the IIDX X axis

compatible: "zmk,behavior-sensor-iidx-x-value"

include: zero_param.yaml

properties:
  "#sensor-binding-cells":
    type: int
    required: true
    const: 0
  index:
    type: int
    required: true
  min:
    type: int
    default: -127
  max:
    type: int
    default: 127
  step:
    type: int
    default: 1
  ticks-per-step:
    type: int
    default: 1
  continuous:
    type: boolean
```
