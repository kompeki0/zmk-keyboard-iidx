## Kconfig
```kconfig
menuconfig ZMK_IIDX_HID
    bool "IIDX-compatible USB HID alongside the ZMK keyboard HID"
    depends on ZMK_USB
    help
      Register a report-ID-less USB HID joystick as HID_1 alongside ZMK's
      standard keyboard HID_0. The input report consists of two absolute
      axes, sixteen button bits, and one constant padding byte.

if ZMK_IIDX_HID

config ZMK_IIDX_HID_INIT_PRIORITY
    int "IIDX HID initialization priority"
    default 95
    help
      The HID interface must be registered before ZMK enables USB. Keep this
      value lower than CONFIG_ZMK_USB_INIT_PRIORITY (96 by default).

config ZMK_IIDX_HID_SEND_TIMEOUT_MS
    int "IIDX HID endpoint timeout in milliseconds"
    range 1 1000
    default 30

config USB_HID_DEVICE_COUNT
    default 2 if ZMK_IIDX_HID
    range 2 2 if ZMK_IIDX_HID

menuconfig ZMK_IIDX_BLE
    bool "IIDX Entry model compatible vendor BLE service"
    depends on ZMK_BLE
    help
      Add the 16-bit 0xFF00 primary service with a notify-only 0xFF01
      characteristic. While IIDX mode is active and USB is disconnected,
      two five-byte notifications are sent per frame.

if ZMK_IIDX_BLE

config ZMK_IIDX_BLE_FRAME_INTERVAL_US
    int "IIDX BLE frame interval in microseconds"
    range 1000 1000000
    default 16667
    help
      16667 microseconds produces approximately 60 frames per second. Each
      frame contains two notifications, for approximately 120 notifications
      per second.

config ZMK_IIDX_BLE_CONN_INTERVAL
    int "Requested BLE connection interval"
    range 6 3200
    default 6
    help
      BLE connection interval in 1.25 millisecond units. The default requests
      7.5 milliseconds. The central device makes the final decision.

config ZMK_IIDX_BLE_CONN_TIMEOUT
    int "Requested BLE supervision timeout"
    range 10 3200
    default 400
    help
      BLE supervision timeout in 10 millisecond units.

endif

endif

config ZMK_VALUE_STORE_SIZE
    int "Value store size"
    default 8
    range 1 64
    help
      Number of integer slots available for behaviors that store adjustable values.
```

## dts/bindings/behaviors/zmk,behavior-iidx-settings.yaml
```yaml
# Copyright (c) 2026 The zmk-iidx contributors
# SPDX-License-Identifier: MIT

description: Adjust and display persistent IIDX controller settings

compatible: "zmk,behavior-iidx-settings"

include: one_param.yaml
```
